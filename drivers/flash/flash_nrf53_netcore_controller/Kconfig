## drivers/flash/flash_nrf53_netcore_controller/Kconfig
```kconfig
# nRF53 netcore flash controller  config

# Copyright (c) 2022 Nordic Semiconductor ASA
#
# SPDX-License-Identifier: LicenseRef-Nordic-5-Clause

config FLASH_NRF53_NETCORE_CONTROLLER
	bool "Flash controller for reading nRF53 netcore flash"
	help
	  TODO add help
```

## samples/dfu/mcuboot_with_encryption/sysbuild/mcuboot/boards/nrf54ls05dk_nrf54ls05b_cpuapp.conf
```kconfig
#
# Copyright (c) 2026 Nordic Semiconductor ASA
#
# SPDX-License-Identifier: LicenseRef-Nordic-5-Clause
#

CONFIG_MCUBOOT_LOG_LEVEL_INF=y
```

## samples/nrf5340/netboot/Kconfig
```kconfig
#
# Copyright (c) 2020 Nordic Semiconductor ASA
#
# SPDX-License-Identifier: LicenseRef-Nordic-5-Clause
#

menu "nRF5340 Network Core Bootloader Sample Settings"

config NETBOOT_MIN_PARTITION_SIZE
	bool "Use minimimum partition size"

partition=B0N_PAD
partition-size=0x200
source "${ZEPHYR_BASE}/../nrf/subsys/partition_manager/Kconfig.template.partition_size"
endmenu

menu "Zephyr Kernel"
source "Kconfig.zephyr"
endmenu
```

## samples/zephyr/subsys/mgmt/mcumgr/smp_svr/sysbuild/mcuboot/boards/nrf54ls05dk_nrf54ls05b_cpuapp.conf
```kconfig
CONFIG_FLASH=y
CONFIG_MAIN_STACK_SIZE=10240

CONFIG_FPROTECT=n
CONFIG_MINIMAL_LIBC=y

# NOTE: To enable mcuboot logs...
# NOTE: ... comment out these...
# CONFIG_SERIAL=n
# CONFIG_CONSOLE=n
# CONFIG_UART_CONSOLE=n
# NOTE: ... and uncomment these
CONFIG_LOG=y
CONFIG_LOG_MODE_MINIMAL=y
CONFIG_LOG_DEFAULT_LEVEL=0
CONFIG_MCUBOOT_LOG_LEVEL_DBG=y
```

## samples/zigbee/light_switch/child_image/mcuboot/dts/bindings/nordic,flash-nrf53-netcore-controller.yaml
```yaml
description: Nordic nRF53 netcore flash controller

compatible: "nordic,flash-nrf53-netcore-controller"
```

## subsys/nrf_compress/Kconfig
```kconfig
#
# Copyright (c) 2024 Nordic Semiconductor ASA
#
# SPDX-License-Identifier: LicenseRef-Nordic-5-Clause
#

menuconfig NRF_COMPRESS
	bool "Compression/decompression library"

if NRF_COMPRESS

config NRF_COMPRESS_COMPRESSION
	bool
	help
	  Enables support for compression functions in library.

config NRF_COMPRESS_DECOMPRESSION
	bool "Decompression support"
	help
	  Enables support for decompression functions in library.

menu "Type support"
	depends on NRF_COMPRESS_COMPRESSION || NRF_COMPRESS_DECOMPRESSION

config NRF_COMPRESS_TYPE_SELECTED
	bool
	help
	  Hidden option to know if at least one implementation has been selected.

menuconfig NRF_COMPRESS_LZMA
	bool "LZMA"
	depends on NRF_COMPRESS_DECOMPRESSION
	select NRF_COMPRESS_TYPE_SELECTED
	help
	  Enables LZMA support for decompression.

if NRF_COMPRESS_LZMA

choice NRF_COMPRESS_LZMA_VERSION
	prompt "Version"
	default NRF_COMPRESS_LZMA_VERSION_LZMA2

config NRF_COMPRESS_LZMA_VERSION_LZMA1
	bool "lzma1"

config NRF_COMPRESS_LZMA_VERSION_LZMA2
	bool "lzma2"

endchoice

endif # NRF_COMPRESS_LZMA

config NRF_COMPRESS_ARM_THUMB
	bool "ARM Thumb"
	depends on NRF_COMPRESS_DECOMPRESSION
	select NRF_COMPRESS_TYPE_SELECTED
	help
	  Enables ARM thumb support for decompression.

endmenu

config NRF_COMPRESS_CHUNK_SIZE
	int "Chunk size"
	default 256
	help
	  The chunk size is the default maximum amount of data that if returned by the
	  decompress_bytes_needed() function. The value is returned by the decompress bytes
	  function that is available. Strive to provide the exact amount returned and not more.
	  If not possible otherwise, for example because of streaming or end of input, a lower
	  amount can be provided as well.

config NRF_COMPRESS_MIN_MEMORY_REQUIRED
	hex
	default 0x26f80 if NRF_COMPRESS_DECOMPRESSION && NRF_COMPRESS_LZMA
	default 0
	help
	  Hidden symbol indicating minimum buffer size for operation if operating in malloc mode.

choice NRF_COMPRESS_MEMORY_TYPE
	prompt "Memory type for buffers"
	default NRF_COMPRESS_MEMORY_TYPE_STATIC

config NRF_COMPRESS_MEMORY_TYPE_STATIC
	bool "Static buffers"
	help
	  Use static buffers to hold the data for decompression. This will reduce the
	  memory available to everything else in the application.

config NRF_COMPRESS_MEMORY_TYPE_MALLOC
	bool "Malloc"
	depends on COMMON_LIBC_MALLOC
	depends on (COMMON_LIBC_MALLOC_ARENA_SIZE = -1) || (COMMON_LIBC_MALLOC_ARENA_SIZE >= NRF_COMPRESS_MIN_MEMORY_REQUIRED)
	help
	  Use the dynamic memory allocation to hold the data for decompression. If there is
	  insufficient free contiguous space, decompression will not be usable.

endchoice

config NRF_COMPRESS_EXTERNAL_DICTIONARY
	bool "External dictionary"
	help
	  Use external dictionary API for LZMA decompression. It provides the user with
	  possibility to store dictionary data in memory areas of their choice (e.g. MRAM).

config NRF_COMPRESS_DICTIONARY_CACHE_SIZE
	int "Dictionary cache size"
	default 1024
	depends on NRF_COMPRESS_EXTERNAL_DICTIONARY
	help
	  Cache for last written dictionary data. It limits the number of external dictionary API calls:
	  'write' and (possibly but not optimized for) 'read'.

config NRF_COMPRESS_MEMORY_ALIGNMENT
	int "Buffer memory alignment"
	default 4
	range 1 32
	help
	  Memory alignment of the output decompression buffer. Set to 1 to disable.

config NRF_COMPRESS_CLEANUP
	bool "Clean up buffers on deinitialization"
	default y
	help
	  If enabled, will clean up all memory buffers in the deinitialization function. This
	  prevents leakage of the information, for example to other boot targets.

	  This option can be disabled if it is not needed and the data contains nothing sensitive.

config NRF_COMPRESS_LZMA_LC
	int "Number of literal context bits"
	default NRF_COMPRESS_GLOBAL_LZMA_LC
	help
	  Allows to fine tune the LZMA calgorithm.
	  Sets the number of bits of the previous literal.
	  When set to 0, the previous literal is ignored.
	  Make sure NRF_COMPRESS_LZMA_LC plus NRF_COMPRESS_LZMA_LP does not exceed NRF_COMPRESS_LZMA_MAX_LCLP.

config NRF_COMPRESS_LZMA_LP
	int "Literal position"
	default NRF_COMPRESS_GLOBAL_LZMA_LP
	help
	  Allows to fine tune the LZMA calgorithm.
	  Takes into acount the position of each literal in the uncompressed data.
	  Make sure NRF_COMPRESS_LZMA_LC plus NRF_COMPRESS_LZMA_LP does not exceed NRF_COMPRESS_LZMA_MAX_LCLP.

config NRF_COMPRESS_LZMA_MAX_LCLP
	int "Max value of sum of lc and lp parameters for LZMA compression"
	default NRF_COMPRESS_GLOBAL_LZMA_MAX_LCLP
	help
	  Allows to fine tune the LZMA calgorithm.
	  Make sure NRF_COMPRESS_LZMA_LC plus NRF_COMPRESS_LZMA_LP does not exceed NRF_COMPRESS_LZMA_MAX_LCLP.

config NRF_COMPRESS_LZMA_MAX_DICT_SIZE
	int "Max size of dictionary used for LZMA"
	default NRF_COMPRESS_GLOBAL_LZMA_MAX_DICT_SIZE
	help
	  Allows to fine tune the LZMA algorithm.
	  Affects amount of RAM needed for decompression.

module = NRF_COMPRESS
module-str = compression/decompression library
source "subsys/logging/Kconfig.template.log_config"

endif # NRF_COMPRESS

menuconfig NRF_COMPRESS_GLOBAL
	bool "Global settings of LZMA compression algorithm"
	# TODO: Should this be set to "n" and enabled in compression samples?
	default y
	help
	  Allows to fine tune LZMA parameters and synchronize then across different build images.

if NRF_COMPRESS_GLOBAL

config NRF_COMPRESS_GLOBAL_LZMA_LC
	int "Number of literal context bits"
	default 3
	help
	  Sets the number of bits of the previous literal.
	  When set to 0, the previous literal is ignored.
	  Make sure NRF_COMPRESS_GLOBAL_LZMA_LC plus NRF_COMPRESS_GLOBAL_LZMA_LP does not exceed NRF_COMPRESS_GLOBAL_LZMA_MAX_LCLP.

config NRF_COMPRESS_GLOBAL_LZMA_LP
	int "Number of literal position bits"
	default 1
	help
	  Takes into acount the position of each literal in the uncompressed data.
	  Make sure NRF_COMPRESS_GLOBAL_LZMA_LC plus NRF_COMPRESS_GLOBAL_LZMA_LP does not exceed NRF_COMPRESS_GLOBAL_LZMA_MAX_LCLP.

config NRF_COMPRESS_GLOBAL_LZMA_MAX_LCLP
	int "Max value of sum of lc and lp parameters for LZMA compression"
	default 4
	help
	  Make sure NRF_COMPRESS_GLOBAL_LZMA_LC plus NRF_COMPRESS_GLOBAL_LZMA_LP does not exceed NRF_COMPRESS_GLOBAL_LZMA_MAX_LCLP.

config NRF_COMPRESS_GLOBAL_LZMA_MAX_DICT_SIZE
	int "Max size of dictionary used for LZMA"
	default 131072
	help
	  Affects amount of RAM needed for decompression.

config NRF_COMPRESS_GLOBAL_LZMA_PB
	int "Number of position bits"
	default 2
	help
	  Sets the number of low bits of the dictionary position to include.

config NRF_COMPRESS_GLOBAL_LZMA_COMPRESSION_PRESET
	int "Compression level preset"
	default 9
	help
	  Determines compression level.
	  Possible values are 0 (lowest compression) to 9 (highest compression).

endif # NRF_COMPRESS_GLOBAL
```
